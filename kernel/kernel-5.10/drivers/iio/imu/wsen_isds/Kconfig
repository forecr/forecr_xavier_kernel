## kernel/kernel-5.10/drivers/iio/imu/wsen_isds/Kconfig
```kconfig
# SPDX-License-Identifier: GPL-2.0-or-later
#
# Würth Elektronik WSEN-ISDS IMU driver configuration
#

config WSEN_ISDS
	tristate "Wurth Elektronik WSEN-ISDS 6-Axis IMU"
	depends on IIO
	select REGMAP
	help
	  Say Y or M here to build support for the Wurth Elektronik
	  WSEN-ISDS (order code 2536030320001) inertial measurement unit.

	  This device provides 3-axis acceleration, 3-axis angular rate
	  (gyroscope) and an internal temperature sensor via I2C or SPI.

	  To compile this driver as a module, choose M here. The module
	  will be called wsen_isds.

config WSEN_ISDS_I2C
	tristate "WSEN-ISDS I2C support"
	depends on WSEN_ISDS && I2C
	select REGMAP_I2C
	help
	  Say Y or M here to enable I2C interface support for the
	  WSEN-ISDS IMU driver.
```

## kernel/kernel-jammy-src/Documentation/devicetree/bindings/mailbox/nvidia,tegra186-hsp.yaml
```yaml
# SPDX-License-Identifier: (GPL-2.0-only OR BSD-2-Clause)
%YAML 1.2
---
$id: http://devicetree.org/schemas/mailbox/nvidia,tegra186-hsp.yaml#
$schema: http://devicetree.org/meta-schemas/core.yaml#

title: NVIDIA Tegra Hardware Synchronization Primitives (HSP)

maintainers:
  - Thierry Reding <thierry.reding@gmail.com>
  - Jon Hunter <jonathanh@nvidia.com>

description: |
  The HSP modules are used for the processors to share resources and
  communicate together. It provides a set of hardware synchronization
  primitives for interprocessor communication. So the interprocessor
  communication (IPC) protocols can use hardware synchronization
  primitives, when operating between two processors not in an SMP
  relationship.

  The features that HSP supported are shared mailboxes, shared
  semaphores, arbitrated semaphores and doorbells.

  The mbox specifier of the "mboxes" property in the client node should
  contain two cells. The first cell determines the HSP type and the
  second cell is used to identify the mailbox that the client is going
  to use.

  For shared mailboxes, the first cell composed of two fields:
    - bits 15..8:
        A bit mask of flags that further specifies the type of shared
        mailbox to be used (based on the data size). If no flag is
        specified then, 32-bit shared mailbox is used.
    - bits 7..0:
        Defines the type of the mailbox to be used. This field should be
        TEGRA_HSP_MBOX_TYPE_SM for shared mailboxes.

  For doorbells, the second cell specifies the index of the doorbell to
  use.

  For shared mailboxes, the second cell is composed of two fields:
    - bits 31..24:
        A bit mask of flags that further specify how the shared mailbox
        will be used. Valid flags are:
          - bit 31:
              Defines the direction of the mailbox. If set, the mailbox
              will be used as a producer (i.e. used to send data). If
              cleared, the mailbox is the consumer of data sent by a
              producer.

    - bits 23..0:
        The index of the shared mailbox to use. The number of available
        mailboxes may vary by instance of the HSP block and SoC
        generation.

    The following file contains definitions that can be used to
    construct mailbox specifiers:

        <dt-bindings/mailbox/tegra186-hsp.h>

properties:
  $nodename:
    pattern: "^hsp@[0-9a-f]+$"

  compatible:
    oneOf:
      - const: nvidia,tegra186-hsp
      - const: nvidia,tegra194-hsp
      - items:
          - const: nvidia,tegra234-hsp
          - const: nvidia,tegra194-hsp

  reg:
    maxItems: 1

  interrupts:
    minItems: 1
    maxItems: 9

  interrupt-names:
    oneOf:
      # shared interrupts are optional
      - items:
          - const: doorbell

      - items:
          - const: doorbell
          - pattern: "^shared[0-7]$"
          - pattern: "^shared[0-7]$"
          - pattern: "^shared[0-7]$"
          - pattern: "^shared[0-7]$"
          - pattern: "^shared[0-7]$"
          - pattern: "^shared[0-7]$"
          - pattern: "^shared[0-7]$"
          - pattern: "^shared[0-7]$"

      - items:
          - pattern: "^shared[0-7]$"
          - pattern: "^shared[0-7]$"
          - pattern: "^shared[0-7]$"
          - pattern: "^shared[0-7]$"

  "#mbox-cells":
    const: 2

  nvidia,mailbox-interrupts:
    description:
      Array nvidia,mailbox-interrupts is an optional property. It specifies
      the mailbox to shared interrupt mapping as <MAILBOXID INTERRUPTID>.
      Whereas, MAILBOXID ranges 0-7 and INTERRUPTID ranges 0-7.
      For example, nvidia,mailbox-interrupts = <0 1> maps mailbox 0 to shared
      interrupt 1.
    minitems: 1
    maxitems: 8

required:
  - compatible
  - reg
  - interrupts
  - interrupt-names
  - mbox-cells

additionalProperties: false

examples:
  - |
    #include <dt-bindings/interrupt-controller/arm-gic.h>
    #include <dt-bindings/mailbox/tegra186-hsp.h>

    hsp_top0: hsp@3c00000 {
        compatible = "nvidia,tegra186-hsp";
        reg = <0x03c00000 0xa0000>;
        interrupts = <GIC_SPI 176 IRQ_TYPE_LEVEL_HIGH>,
                     <GIC_SPI 120 IRQ_TYPE_LEVEL_HIGH>,
                     <GIC_SPI 121 IRQ_TYPE_LEVEL_HIGH>,
                     <GIC_SPI 122 IRQ_TYPE_LEVEL_HIGH>,
                     <GIC_SPI 123 IRQ_TYPE_LEVEL_HIGH>,
                     <GIC_SPI 124 IRQ_TYPE_LEVEL_HIGH>,
                     <GIC_SPI 125 IRQ_TYPE_LEVEL_HIGH>,
                     <GIC_SPI 126 IRQ_TYPE_LEVEL_HIGH>,
                     <GIC_SPI 127 IRQ_TYPE_LEVEL_HIGH>;
        interrupt-names = "doorbell", "shared0", "shared1", "shared2",
                          "shared3", "shared4", "shared5", "shared6",
                          "shared7";
        interrupt-names = "doorbell";
        nvidia,mailbox-interrupts = <0 1>,
                                    <1 2>;
        #mbox-cells = <2>;
    };

    client {
        mboxes = <&hsp_top0 TEGRA_HSP_MBOX_TYPE_DB TEGRA_HSP_DB_MASTER_CCPLEX>;
    };
```

## kernel/kernel-jammy-src/Documentation/devicetree/bindings/platform/tegra/tegra-epl.yaml
```yaml
# SPDX-License-Identifier: (GPL-2.0 OR BSD-2-Clause)
%YAML 1.2
---
$id: http://devicetree.org/schemas/platform/tegra/tegra-epl.yaml#
$schema: http://devicetree.org/meta-schemas/core.yaml#

title: Device tree binding for NVIDIA Tegra EPL

maintainers:
  - Rahul Bedarkar <rabedarkar@nvidia.com>

description: |
   The tegra-epl driver provides interface for reporting software detected errors
   to Functional Safety Island (FSI) via HSP mailbox or MISC EC registers.

properties:
  compatible:
    enum:
      - nvidia,tegra234-epl-client

  mboxes:
    maxItems: 1
    description: |
       Specifies TX mailbox.

  mbox-names:
    maxItems: 1
    description: |
       Specifies the name for TX mailbox. It should be "epl-tx".

  reg:
    minItems: 11
    maxItems: 11
    description: |
       Address and size pairs of MISC EC error and assert registers followed by
       address and size of mission error status register.

  client-misc-sw-generic-err0:
    description: |
       Device driver's name for reporting errors via MISCREG_MISC_EC_ERR0_SW_ERR_CODE_0.

  client-misc-sw-generic-err1:
    description: |
       Device driver's name for reporting errors via MISCREG_MISC_EC_ERR1_SW_ERR_CODE_0.

  client-misc-sw-generic-err2:
    description: |
       Device driver's name for reporting errors via MISCREG_MISC_EC_ERR2_SW_ERR_CODE_0.

  client-misc-sw-generic-err3:
    description: |
       Device driver's name for reporting errors via MISCREG_MISC_EC_ERR3_SW_ERR_CODE_0.

  client-misc-sw-generic-err4:
    description: |
       Device driver's name for reporting errors via MISCREG_MISC_EC_ERR4_SW_ERR_CODE_0.

required:
  - compatible
  - mboxes
  - mbox-names
  - reg

additionalProperties: false

examples:
  - |
    #include <dt-bindings/mailbox/tegra186-hsp.h>

    soc {
        #address-cells = <2>;
        #size-cells = <2>;
        epl_client@110000 {
            compatible = "nvidia,tegra234-epl-client";
            mboxes =
                <&hsp_top2 (TEGRA_HSP_MBOX_TYPE_SM | TEGRA_HSP_MBOX_TYPE_SM_128BIT) TEGRA_HSP_SM_RX(1)>;
            mbox-names = "epl-tx";
            reg = <0x0 0x00110000 0x0 0x4>,
                  <0x0 0x00110004 0x0 0x4>,
                  <0x0 0x00120000 0x0 0x4>,
                  <0x0 0x00120004 0x0 0x4>,
                  <0x0 0x00130000 0x0 0x4>,
                  <0x0 0x00130004 0x0 0x4>,
                  <0x0 0x00140000 0x0 0x4>,
                  <0x0 0x00140004 0x0 0x4>,
                  <0x0 0x00150000 0x0 0x4>,
                  <0x0 0x00150004 0x0 0x4>,
                  <0x0 0x024e0038 0x0 0x4>;
            client-misc-sw-generic-err0 = "fsicom_client";
            client-misc-sw-generic-err4 = "gk20e";
        };

     };
...
```

## kernel/kernel-jammy-src/Documentation/devicetree/bindings/platform/tegra/tegra-hsierrrptinj.yaml
```yaml
# SPDX-License-Identifier: (GPL-2.0 OR BSD-2-Clause)
%YAML 1.2
---
$id: http://devicetree.org/schemas/platform/tegra/tegra-hsierrrptinj.yaml#
$schema: http://devicetree.org/meta-schemas/core.yaml#

title: Device tree binding for NVIDIA Tegra HSIERRRPTINJ

maintainers:
  - Prasun Kumar <prasunk@nvidia.com>

description: |
   The tegra-hsierrrptinj driver provides interface for forwarding HSI error reports
   to an external supervision MCU connected to the device via an SPI interface.

properties:
  compatible:
    enum:
      - nvidia,tegra23x-hsierrrptinj

  mboxes:
    maxItems: 1
    description: |
       Specifies TX mailbox.

  mbox-names:
    maxItems: 1
    description: |
       Specifies the name for TX mailbox. It should be "hsierrrptinj-tx".

required:
  - compatible
  - mboxes
  - mbox-names

additionalProperties: false

examples:
  - |
    #include <dt-bindings/mailbox/tegra186-hsp.h>

    soc {
        #address-cells = <2>;
        #size-cells = <2>;
        hsierrrptinj {
            mboxes =
                <&hsp_top (TEGRA_HSP_MBOX_TYPE_SM | TEGRA_HSP_MBOX_TYPE_SM_128BIT) TEGRA_HSP_SM_TX(1)>;
            mbox-names = "hsierrrptinj-tx";
            status = "okay";
        };

     };
...
```

## kernel/kernel-jammy-src/Documentation/devicetree/bindings/usb/cypress,cypd4226.yaml
```yaml
# SPDX-License-Identifier: (GPL-2.0 OR BSD-2-Clause)
%YAML 1.2
---
$id: http://devicetree.org/schemas/usb/cypress,cypd4226.yaml#
$schema: http://devicetree.org/meta-schemas/core.yaml#

title: Cypress cypd4226 UCSI I2C Type-C Controller

maintainers:
  - Wayne Chang <waynec@nvidia.com>

description:
  The Cypress cypd4226 UCSI I2C type-C controller is a I2C interface type-C
  controller.

properties:
  compatible:
    const: cypress,cypd4226

  '#address-cells':
    const: 1

  '#size-cells':
    const: 0

  reg:
    const: 0x08

  interrupts:
    items:
      - description: cypd4226 I2C interrupt

  cypress,firmware-build:
    enum:
      - nvidia,gpu
      - nvidia,jetson-agx-xavier
    description: |
      the name of the CCGx firmware built for product series.
      should be set one of following:
      - "nvidia,gpu" for the NVIDIA RTX product series
      - "nvidia,jetson-agx-xavier" for the NVIDIA Jetson product series

patternProperties:
  '^connector@[0-1]+$':
    $ref: /schemas/connector/usb-connector.yaml#
    properties:
      reg:
        maxItems: 1

required:
  - compatible
  - reg
  - interrupts

additionalProperties: false

examples:
  - |
    #include <dt-bindings/gpio/tegra194-gpio.h>
    #include <dt-bindings/interrupt-controller/arm-gic.h>
    i2c {
      #address-cells = <1>;
      #size-cells = <0>;
      #interrupt-cells = <2>;

      ucsi-ccg@8 {
        compatible = "cypress,cypd4226";
        interrupt-parent = <&gpio_aon>;
        interrupts = <TEGRA194_AON_GPIO(BB, 2) IRQ_TYPE_LEVEL_LOW>;
        reg = <0x08>;
        cypress,firmware-build = "nvidia,jetson-agx-xavier";
        #address-cells = <1>;
        #size-cells = <0>;
        ccg_typec_con0: connector@0 {
          compatible = "usb-c-connector";
          reg = <0>;
          label = "USB-C";
          data-role = "dual";
          port {
            ucsi_ccg_p0: endpoint {
              remote-endpoint = <&usb_role_switch0>;
            };
          };
        };
      };
    };
```

## kernel/kernel-noble/Documentation/devicetree/bindings/iio/imu/we,wsen-isds.yaml
```yaml
# SPDX-License-Identifier: GPL-2.0-or-later OR BSD-2-Clause
# Copyright (C) 2024 Your Name
%YAML 1.2
---
$id: http://devicetree.org/schemas/iio/imu/we,wsen-isds.yaml#
$schema: http://devicetree.org/meta-schemas/core.yaml#

title: Wurth Elektronik WSEN-ISDS 6-Axis IMU (2536030320001)

description: |
  Wurth Elektronik WSEN-ISDS (order code 2536030320001) is a 6-axis
  MEMS inertial measurement unit combining:
    - 3-axis accelerometer (±2 / ±4 / ±8 / ±16 g, up to 6.664 kHz ODR)
    - 3-axis gyroscope (±125 / ±250 / ±500 / ±1000 / ±2000 dps)
    - Integrated temperature sensor (-40 °C to +85 °C)

  I²C addresses:
    0x6A  (SAO pin low)
    0x6B  (SAO pin high)

  Datasheet:
    https://www.we-online.com/components/products/datasheet/2536030320001.pdf

properties:
  compatible:
    const: we,wsen-isds-2536030320001

  reg:
    description: I2C address; 0x6A when SAO is low, 0x6B when SAO is high.
    enum: [0x6A, 0x6B]

  vdd-supply:
    description: Regulator providing VDD (1.71 V – 3.6 V)

  vddio-supply:
    description: Regulator providing VDD_IO for I/O pins (1.62 V – 3.6 V)

  interrupts:
    description: |
      Up to two interrupt lines (INT_0 and INT_1).
      INT_0 is pin 4, INT_1 is pin 9 on the LGA-14 package.
    minItems: 1
    maxItems: 2

  interrupt-names:
    description: Names for the interrupt signals.
    items:
      - const: INT_0
      - const: INT_1

required:
  - compatible
  - reg

additionalProperties: false

examples:
  - |
    #include <dt-bindings/interrupt-controller/irq.h>

    i2c {
        #address-cells = <1>;
        #size-cells    = <0>;

        imu@6a {
            compatible  = "we,wsen-isds-2536030320001";
            reg         = <0x6A>;
            vdd-supply  = <&vdd_3v3>;
            vddio-supply = <&vdd_3v3>;

            interrupt-parent = <&gpio1>;
            interrupts = <5 IRQ_TYPE_EDGE_RISING>;
            interrupt-names = "INT_0";
        };
    };
```
